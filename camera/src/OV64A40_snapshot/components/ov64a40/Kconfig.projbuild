## camera/src/OV64A40_snapshot/components/ov64a40/Kconfig.projbuild
```kconfig
menu "Camera Sensor (omnivision)"

    config CAMERA_OV64A40
        bool "Support OV64A40 (Raspberry Pi Camera Module v2)"
        default n
        help
            Enable the Sony OV64A40 MIPI-CSI driver.

            Verified on hardware as of 0.2.0: streaming, auto-exposure through
            esp_video's 3A loop, stills and H.264 video.

            Still off by default only because a build should not carry two
            sensors' register tables when it uses one. Turn it on for an IMX219
            and turn CAMERA_IMX708 off.

    if CAMERA_OV64A40

        config CAMERA_OV64A40_AUTO_DETECT_MIPI_INTERFACE_SENSOR
            bool "Auto-detect OV64A40 on the MIPI-CSI interface"
            default y
            help
                Register the OV64A40 in the esp_cam_sensor auto-detect list so
                esp_video probes for it automatically at start-up.

        config CAMERA_OV64A40_MIPI_IF_FORMAT_INDEX_DEFAULT
            int "Default MIPI-CSI mode index"
            default 0
            range 0 0
            help
                The driver currently supports only mode 0:
                1920x1080 RAW10 at 60 fps.

    endif # CAMERA_OV64A40
endmenu
```
